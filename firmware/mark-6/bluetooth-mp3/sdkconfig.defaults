## firmware/mark-6/bluetooth-mp3/sdkconfig.defaults
```kconfig
# Override some defaults so BT stack is enabled and
# Classic BT is enabled
CONFIG_BT_ENABLED=y
CONFIG_BTDM_CTRL_MODE_BLE_ONLY=n
CONFIG_BTDM_CTRL_MODE_BR_EDR_ONLY=y
CONFIG_BTDM_CTRL_MODE_BTDM=n
CONFIG_BT_BLUEDROID_ENABLED=y
CONFIG_BT_CLASSIC_ENABLED=y
CONFIG_BT_A2DP_ENABLE=y
CONFIG_EXAMPLE_PEER_DEVICE_NAME="SoundCore 2"
CONFIG_ESPTOOLPY_FLASHSIZE_4MB=y
CONFIG_ESPTOOLPY_FLASHMODE_DIO=y
CONFIG_ESP_DEFAULT_CPU_FREQ_MHZ_240=y
CONFIG_SPIRAM=y
CONFIG_SPIRAM_USE_MALLOC=y
CONFIG_SPIRAM_MEMTEST=y
CONFIG_PARTITION_TABLE_CUSTOM=y
CONFIG_PARTITION_TABLE_CUSTOM_FILENAME="partitions.csv"
CONFIG_BENCH_DISPLAY_SOFT_SPI=y
```

## firmware/mark-6/components/bench_display/Kconfig
```kconfig
menu "Mark-6 display bench"
config BENCH_DISPLAY_SOFT_SPI
    bool "Use software SPI for display isolation"
    default n
config BENCH_DISPLAY_SIGNAL_CHECK
    bool "Run static display-pin diagnostic instead of drawing"
    default n
endmenu
```

## firmware/mark-6/display-probe/sdkconfig.defaults
```kconfig
CONFIG_ESPTOOLPY_FLASHSIZE_4MB=y
CONFIG_ESPTOOLPY_FLASHMODE_DIO=y
CONFIG_BENCH_DISPLAY_SOFT_SPI=y
CONFIG_BENCH_DISPLAY_SIGNAL_CHECK=y
```

## firmware/mark-6/feather-carrier/sdkconfig.defaults
```kconfig
# Override some defaults so BT stack is enabled and
# Classic BT is enabled
CONFIG_BT_ENABLED=y
CONFIG_BTDM_CTRL_MODE_BLE_ONLY=n
CONFIG_BTDM_CTRL_MODE_BR_EDR_ONLY=y
CONFIG_BTDM_CTRL_MODE_BTDM=n
CONFIG_BT_BLUEDROID_ENABLED=y
CONFIG_BT_CLASSIC_ENABLED=y
CONFIG_BT_A2DP_ENABLE=y
CONFIG_EXAMPLE_PEER_DEVICE_NAME="SoundCore 2"
CONFIG_ESPTOOLPY_FLASHSIZE_8MB=y
CONFIG_ESPTOOLPY_FLASHMODE_DIO=y
CONFIG_ESP_DEFAULT_CPU_FREQ_MHZ_240=y
CONFIG_SPIRAM=y
CONFIG_SPIRAM_USE_MALLOC=y
CONFIG_SPIRAM_MEMTEST=y
CONFIG_PARTITION_TABLE_CUSTOM=y
CONFIG_PARTITION_TABLE_CUSTOM_FILENAME="partitions.csv"
CONFIG_CARRIER_EXPECTED_MAC=""
CONFIG_FREERTOS_HZ=1000

CONFIG_CARRIER_CONTROLS_ACTIONS=y

CONFIG_CARRIER_ANO_ROTATION=1
CONFIG_FATFS_LFN_HEAP=y
CONFIG_FATFS_MAX_LFN=255
CONFIG_FATFS_API_ENCODING_UTF_8=y
```

## firmware/mark-6/feather-display-bench/sdkconfig.defaults
```kconfig
CONFIG_ESPTOOLPY_FLASHSIZE_8MB=y
CONFIG_ESPTOOLPY_FLASHMODE_DIO=y
CONFIG_ESP_DEFAULT_CPU_FREQ_MHZ_240=y
CONFIG_SPIRAM=y
CONFIG_SPIRAM_USE_MALLOC=y
CONFIG_SPIRAM_MEMTEST=y
CONFIG_SPIRAM_IGNORE_NOTFOUND=n
CONFIG_BT_ENABLED=n
CONFIG_ESP_WIFI_ENABLED=n

CONFIG_FATFS_LFN_HEAP=y

CONFIG_FATFS_API_ENCODING_UTF_8=y
```

## firmware/mark-6/feather-player-bench/components/carrier_board/Kconfig.projbuild
```kconfig
menu "Harmony Feather carrier"
    config CARRIER_EXPECTED_MAC
        string "Commissioned Feather Wi-Fi station MAC (xx:xx:xx:xx:xx:xx)"
        default ""
        help
            Empty by default. The application exits before peripheral GPIO
            changes until this matches the physically identified Feather V2.
    config CARRIER_CONTROLS_DIAGNOSTIC
        bool "Enable ANO input reader and raw event logs"
        default y
    config CARRIER_CONTROLS_ACTIONS
        bool "Enable debounced playback actions"
        depends on CARRIER_CONTROLS_DIAGNOSTIC
        default y
    config CARRIER_ANO_ROTATION
        int "Clockwise quarter-turns from raw ANO labels"
        range 0 3
        default 1
        help
            Provisional rotated case mapping. Verify all four directions on
            the delivered assembly before qualification.
    config CARRIER_ENCODER_REVERSE
        bool "Reverse album browse encoder direction"
        default n
    config CARRIER_DISPLAY_ONLY
        bool "Draw display test pattern and exit before SD/Bluetooth initialization"
        default n
        help
            Use for the first visual display check on commissioned hardware.
            The default build prepares the album integration bench.
endmenu
```

## firmware/mark-6/feather-player-bench/main/Kconfig.projbuild
```kconfig
menu "A2DP Example Configuration"
    config EXAMPLE_SSP_ENABLED
        bool "Secure Simple Pairing"
        depends on BT_CLASSIC_ENABLED
        default y
        help
            This enables the Secure Simple Pairing. If disable this option,
            Bluedroid will only support Legacy Pairing

    config EXAMPLE_PEER_DEVICE_NAME
        string "Target Device Name"
        default "ESP_SPEAKER"
        help
            Use this option to set target device name to connect.
endmenu

config BENCH_PEER_MAC
    string "Known Bluetooth receiver MAC"
    default "f4:2b:7d:5a:35:43"
```

## firmware/mark-6/feather-player-bench/sdkconfig.defaults
```kconfig
# Override some defaults so BT stack is enabled and
# Classic BT is enabled
CONFIG_BT_ENABLED=y
CONFIG_BTDM_CTRL_MODE_BLE_ONLY=n
CONFIG_BTDM_CTRL_MODE_BR_EDR_ONLY=y
CONFIG_BTDM_CTRL_MODE_BTDM=n
CONFIG_BT_BLUEDROID_ENABLED=y
CONFIG_BT_CLASSIC_ENABLED=y
CONFIG_BT_A2DP_ENABLE=y
CONFIG_EXAMPLE_PEER_DEVICE_NAME="SoundCore 2"
CONFIG_ESPTOOLPY_FLASHSIZE_8MB=y
CONFIG_ESPTOOLPY_FLASHMODE_DIO=y
CONFIG_ESP_DEFAULT_CPU_FREQ_MHZ_240=y
CONFIG_SPIRAM=y
CONFIG_SPIRAM_USE_MALLOC=y
CONFIG_SPIRAM_MEMTEST=y
CONFIG_PARTITION_TABLE_CUSTOM=y
CONFIG_PARTITION_TABLE_CUSTOM_FILENAME="partitions.csv"
CONFIG_CARRIER_EXPECTED_MAC="14:33:5c:99:1a:28"
CONFIG_FREERTOS_HZ=1000

CONFIG_CARRIER_CONTROLS_ACTIONS=y

CONFIG_CARRIER_ANO_ROTATION=0
CONFIG_FATFS_LFN_HEAP=y
CONFIG_FATFS_MAX_LFN=255
CONFIG_FATFS_API_ENCODING_UTF_8=y

CONFIG_BENCH_PEER_MAC="f4:2b:7d:5a:35:43"
```
